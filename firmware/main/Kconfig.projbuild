## firmware/main/Kconfig.projbuild
```kconfig
menu "Example Configuration"

    config WIFI_SSID 
        string "WiFi SSID"
        default "Tang 3"
        help
            The SSID of the WiFi network to connect to.

    config WIFI_PASSWORD
        string "WiFi Password"
        default "so15quyetthang"
        help
            The password of the WiFi network to connect to.
    
    config MAX_TIMEOUT
        int "Max timeout"
        default 10000
        help 
            Max timeout for peripheral
    
    config BUFFER_SIZE 
        int "Buffer size"
        default 1024
        help
            Receiver buffer array size
    
    config SAMPLE_RATE
        int "Sample rate"
        default 44100 
        help
            Sample rate of microphone
    
    config SAMPLE_BITS
        int "Sample bits"
        default 16
        help
            Sample bits of microphone
    
    config WS_URI
        string "Websocket URI"
        default "ws://192.168.1.6:8080"
        help
            Websocket URI to connect to server

    config VTS_UDP_SERVER_IP
        string "VTS UDP server IP"
        default "192.168.1.6"
        help
            IP address of voice to server server

    config VTS_UDP_SERVER_PORT
        int "VTS UDP sever port"
        default 3000
        help
            UDP port to send data to voice to server server


endmenu
```

## firmware/main/Kconfig.projbuild.example
```kconfig
menu "Example Configuration"

    config WIFI_SSID 
        string "WiFi SSID"
        default "Ten wifi"
        help
            The SSID of the WiFi network to connect to.

    config WIFI_PASSWORD
        string "WiFi Password"
        default "Mat Khau"
        help
            The password of the WiFi network to connect to.

    config MAX_TIMEOUT
        int "Max timeout"
        default 10000
        help 
            Max timeout for peripheral
    
    config MICROPHONE_RECV_BUF_SIZE
        int "Microphone buffer size"
        default 1024 
        help
            Receiver buffer array size when using microphone

    config SAMPLE_RATE
        int "Sample rate"
        default 16000
        help
            Sample rate of microphone
    
    config SAMPLE_BITS
        int "Sample bits"
        default 16
        help
            Sample bits of microphone
    
    config WS_URI
        string "Websocket URI"
        default "ws://tinasha.loca.lt"
        help
            Websocket URI to connect to server

    config VTS_UDP_SERVER_IP
        string "VTS UDP server IP"
        default "192.168.1.6"
        help
            IP address of voice to server server

    config VTS_UDP_SERVER_PORT
        int "VTS UDP server port"
        default 5000
        help
            UDP port to send data to voice to server server
    
    config TINASHA_TCP_SERVER_PORT
        int "Tinasha TCP server port"
        default 4444
        help
            TCP port to send data to Tinasha server

    config TCP_BUFFER_SIZE
        int "TCP buffer size"
        default 512
        help
            TCP buffer size

endmenu
```

## firmware/src/Kconfig.projbuild.example
```kconfig
menu "Example Configuration"

    config WIFI_SSID 
        string "WiFi SSID"
        default "Ten wifi"
        help
            The SSID of the WiFi network to connect to.

    config WIFI_PASSWORD
        string "WiFi Password"
        default "Mat Khau"
        help
            The password of the WiFi network to connect to.

    config MAX_TIMEOUT
        int "Max timeout"
        default 10000
        help 
            Max timeout for peripheral
    
    config MICROPHONE_RECV_BUF_SIZE
        int "Microphone buffer size"
        default 2400
        help
            Receiver buffer array size when using microphone

    config SAMPLE_RATE
        int "Sample rate"
        default 16000
        help
            Sample rate of microphone
    
    config SAMPLE_BITS
        int "Sample bits"
        default 16
        help
            Sample bits of microphone

endmenu
```
